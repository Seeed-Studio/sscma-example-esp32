## components/edgelab/Kconfig
```kconfig
menu "Edgelab Configuration"

    rsource "src/ports/Kconfig"

    config EL_DEBUG
        bool "Log debug"
        default y
        help
            Enable Edgelab debug
    menu "debug options"
        depends on EL_DEBUG
        config EL_DEBUG_COLOR
            bool "color"
            default y
            help
                Enable Edgelab debug color
        config EL_DEBUG_MORE_INFO
            bool "more info"
            default y
            help
                Enable Edgelab debug more info
        config EL_DEBUG_LEVEL
            int "level"
            default 3
            range 0 4
            help
                Edgelab debug level
        config EL_ASSERT
            bool "assert"
            default y
            help
                Enable Edgelab assert
    endmenu


    rsource "src/inference/Kconfig"
    rsource "third_party/Kconfig"

endmenu
```

## components/edgelab/src/algorithm/Kconfig
```kconfig
menu "Algorithm Configuration"
    config EL_ALGORITHM_YOLO
        bool "YOLO"
        default y
        help
            Enable YOLO algorithm
endmenu
```

## components/edgelab/third_party/Kconfig
```kconfig
menu "Third Party"
    config EL_LIB_JPEGENC
        bool "JPEGENC"
        default y
        help
            Enable SoftWare JPEG encoder
endmenu
```

## components/madeploy/Kconfig
```kconfig
menu "ModelAssistant Depoly Configuration"
    choice MA_DEPLOY_BOARD 
        prompt "Select board"
        default MA_PORTING_SEEED_XIAO_ESP32S3

        config MA_PORTING_SEEED_XIAO_ESP32S3
            bool "Seeed XIAO-ESP32-S3"
            
        config MA_PORTING_ESPRESSIF_ESP32S3_EYE
            bool "Espressif ESP32S3-EYE"
    endchoice
endmenu

   
```

## examples/at_server_demo/sdkconfig.defaults
```kconfig
CONFIG_ESPTOOLPY_FLASHSIZE_4MB=y

CONFIG_ESPTOOLPY_FLASHFREQ_80M=y
CONFIG_ESPTOOLPY_FLASHMODE_QIO=y

CONFIG_SPIRAM_SPEED_80M=y

CONFIG_PARTITION_TABLE_CUSTOM=y
CONFIG_PARTITION_TABLE_CUSTOM_FILENAME="partitions.csv"


// EdgeLab config
CONFIG_EL_TARGET_ESPRESSIF=y
CONFIG_EL_TFLITE=y
CONFIG_EL_TFLITE_OP_CONV_2D=y
CONFIG_EL_TFLITE_OP_RESHAPE=y
CONFIG_EL_TFLITE_OP_SHAPE=y
CONFIG_EL_TFLITE_OP_PACK=y
CONFIG_EL_TFLITE_OP_PAD=y
CONFIG_EL_TFLITE_OP_PADV2=y
CONFIG_EL_TFLITE_OP_SUB=y
CONFIG_EL_TFLITE_OP_ADD=y
CONFIG_EL_TFLITE_OP_RELU=y
CONFIG_EL_TFLITE_OP_MAX_POOL_2D=y
CONFIG_EL_TFLITE_OP_SPLIT=y
CONFIG_EL_TFLITE_OP_CONCATENATION=y
CONFIG_EL_TFLITE_OP_RESIZE_NEAREST_NEIGHBOR=y
CONFIG_EL_TFLITE_OP_QUANTIZE=y
CONFIG_EL_TFLITE_OP_TRANSPOSE=y
CONFIG_EL_TFLITE_OP_LOGISTIC=y
CONFIG_EL_TFLITE_OP_MUL=y
CONFIG_EL_TFLITE_OP_SPLIT_V=y
CONFIG_EL_TFLITE_OP_STRIDED_SLICE=y
CONFIG_EL_TFLITE_OP_MEAN=y
CONFIG_EL_TFLITE_OP_SOFTMAX=y
CONFIG_EL_TFLITE_OP_DEPTWISE_CONV_2D=y
CONFIG_EL_TFLITE_OP_LEAKY_RELU=y
```

## examples/gyro_anomaly_detection_nn/sdkconfig.defaults
```kconfig
CONFIG_ESPTOOLPY_FLASHSIZE_4MB=y

CONFIG_ESPTOOLPY_FLASHFREQ_80M=y
CONFIG_ESPTOOLPY_FLASHMODE_QIO=y

CONFIG_SPIRAM_SPEED_80M=y

CONFIG_PARTITION_TABLE_CUSTOM=y
CONFIG_PARTITION_TABLE_CUSTOM_FILENAME="partitions.csv"

CONFIG_ESP_TIMER_TASK_STACK_SIZE=8192

CONFIG_FREERTOS_HZ=1000
CONFIG_FREERTOS_TIMER_TASK_PRIORITY=5
CONFIG_FREERTOS_TIMER_TASK_STACK_DEPTH=8192

CONFIG_TIMER_TASK_PRIORITY=5
CONFIG_TIMER_TASK_STACK_SIZE=8192
CONFIG_TIMER_TASK_STACK_DEPTH=8192

CONFIG_MAIN_TASK_STACK_SIZE=10240


CONFIG_INT_WDT_TIMEOUT_MS=3000
```

## examples/sscma_client_proxy/main/Kconfig
```kconfig
menu "Application Configuration"

	menu "WiFi Setting"

		config ESP_WIFI_SSID
			string "WiFi SSID"
			default "myssid"
			help
				SSID (network name) to connect to.

		config ESP_WIFI_PASSWORD
			string "WiFi Password"
			default "mypassword"
			help
				WiFi password (WPA or WPA2) to connect to.

		config ESP_MAXIMUM_RETRY
			int "Maximum retry"
			default 5
			help
				Set the Maximum retry to avoid station reconnecting to the AP unlimited when the AP is really inexistent.
    endmenu

    menu "MQTT Server Setting"

		config MQTT_BROKER
			string "MQTT Broker"
			default "esp32-broker.local"
			help
				Host name or IP address of the broker to connect to
        
        config MQTT_CREADENTIAL_USERNAME
            string "Creadential Username"
            default ""
            help
                Creadential Username
        
        config MQTT_CREADENTIAL_PASSWORD
            string "Creadential Password"
            default ""
            help
                Creadential Password

	endmenu

        
endmenu
```
